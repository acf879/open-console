## CMakeLists.txt
```
# SPDX-License-Identifier: Apache-2.0

cmake_minimum_required(VERSION 3.20.0)

find_package(Zephyr REQUIRED HINTS $ENV{ZEPHYR_BASE})
project(base_console)

FILE(GLOB app_sources src/*.c*)
target_sources(app PRIVATE ${app_sources})
```

## sysbuild.conf
```
# Enable MCUboot per default for this sample.
SB_CONFIG_BOOTLOADER_MCUBOOT=y
```

## prj.conf
```kconfig
CONFIG_MAIN_STACK_SIZE=2048
CONFIG_HEAP_MEM_POOL_SIZE=16384

CONFIG_LOG=y
CONFIG_LOG_MODE_IMMEDIATE=y

CONFIG_SHELL=y
CONFIG_I2C_SHELL=y

CONFIG_DISPLAY=y
# CURRENTLY NOT IMPLEMENTED BELOW

# FILE STRUCTURE
CONFIG_FLASH=y
CONFIG_FILE_SYSTEM=y
CONFIG_FILE_SYSTEM_SHELL=y

CONFIG_FILE_SYSTEM_LITTLEFS=y
CONFIG_FLASH_MAP=y

# WATCHDOG
CONFIG_WATCHDOG=y
CONFIG_WDT_LOG_LEVEL_DBG=y
CONFIG_WDT_DISABLE_AT_BOOT=y

CONFIG_TASK_WDT=y
CONFIG_TASK_WDT_MIN_TIMEOUT=500

CONFIG_THREAD_NAME=y
```

## src/main.c
```c
#include <stdio.h>
#include <zephyr/kernel.h>
#include <zephyr/device.h>

// Does not need to reference anything just needs to be linked
#include "terminal.h"

int main() {
	printf("Hello World! %s\n", CONFIG_BOARD_TARGET);
	for (;;) {
        k_msleep(1000);
    }
    return 0;
}
```

## src/console_properties.h
```c
#ifndef GAME_ENGINE_PROPERTIES_H_
#define GAME_ENGINE_PROPERTIES_H_

uint32_t delta_time_us = 1000; // Time delay per frame 

#endif
```

## src/eeprom.c
```c
#include <zephyr/kernel.h>
#include <zephyr/drivers/eeprom.h>
#include "eeprom.h"
```

## src/eeprom.h
```c
#ifndef EEPROM_H_
#define EEPROM_H_



#endif
```

## src/game_object.c
```c
#include <stdbool.h>
#include "../game_engine/game_object.h"

bool set_tag(Game_Object obj, const Tag tag) {
  return true;
}
bool set_hit_box(Game_Object obj, const Hit_Box hit_box, const size_t hit_box_size) {
  return true;
}
bool set_group(Game_Object obj, const Group group) {
  return true;
}
bool set_is_trigger(Game_Object obj, const bool is_trigger) {
  return true;
}
bool is_trigger(const Game_Object obj) {
  return true;
}
bool is_colliding(const Game_Object object_1, const Game_Object object_2) {
  return true;
}
```

## src/helper_functions.h
```c
#ifndef HELPER_FUNCTIONS_H_
#define HELPER_FUNCTIONS_H_

static inline void minimal_delay() {
    __asm__(
            "nop\n\t"
           );
    return;
}

#endif
```

## src/simple_movement.c
```c
#include "../game_engine/movement.h"
#include "../game_engine/game_errors.h"
#include "../game_engine/game_bounds.h"

Bounds_Error_Check move_constant_forwards(Global_Position position, const unsigned int x_amount, Bounds_Error_Check bounds) {
    position.global_x_position = position.global_x_position + x_amount;
    if (position.global_x_position >= MAX_X_BOUND) {
      bounds.x_bounds = OUT_OF_BOUNDS_POSITIVE;
      return bounds;
    } else if (position.global_x_position <= MIN_X_BOUND) {
      bounds.x_bounds = OUT_OF_BOUNDS_NEGATIVE;
      return bounds;
    }
    bounds.x_bounds = IN_BOUNDS;
    return bounds; 
}

Bounds_Error_Check move_constant_backwards(Global_Position position, const unsigned int x_amount, Bounds_Error_Check bounds) {
    if (position.global_x_position < x_amount) {
      position.global_x_position = x_amount; // set so it becomes 0 
    }
    position.global_x_position = position.global_x_position - x_amount;
    bounds = move_constant_forwards(position, 0, bounds); // check bounds 
    return bounds; 
}

Bounds_Error_Check move_constant_upwards(Global_Position position, const unsigned int z_amount, Bounds_Error_Check bounds) {
    position.global_z_position = position.global_z_position + z_amount;
    if (position.global_z_position >= MAX_Z_BOUND) {
      bounds.z_bounds = OUT_OF_BOUNDS_POSITIVE;
      return bounds;
    } else if (position.global_z_position <= MIN_Z_BOUND) {
      bounds.z_bounds = OUT_OF_BOUNDS_NEGATIVE;
      return bounds;
    }
    bounds.z_bounds = IN_BOUNDS;
    return bounds; 
}

Bounds_Error_Check move_constant_downwards(Global_Position position, const unsigned int z_amount, Bounds_Error_Check bounds) {
    if (position.global_z_position < z_amount) {
      position.global_z_position = z_amount; // set so it becomes 0 
    }
    position.global_z_position = position.global_z_position - z_amount;
    bounds = move_constant_upwards(position, 0, bounds); // check bounds 
    return bounds; 
}

Bounds_Error_Check move_constant_leftwards(Global_Position position, const unsigned int y_amount, Bounds_Error_Check bounds) {
    position.global_y_position = position.global_y_position + y_amount;
    if (position.global_y_position >= MAX_Y_BOUND) {
      bounds.y_bounds = OUT_OF_BOUNDS_POSITIVE;
      return bounds;
    } else if (position.global_y_position <= MIN_Y_BOUND) {
      bounds.y_bounds = OUT_OF_BOUNDS_NEGATIVE;
      return bounds;
    }
    bounds.y_bounds = IN_BOUNDS;
    return bounds; 
}

Bounds_Error_Check move_constant_rightwards(Global_Position position, const unsigned int y_amount, Bounds_Error_Check bounds) {
    if (position.global_y_position < y_amount) {
      position.global_y_position = y_amount; // set so it becomes 0 
    }
    position.global_y_position = position.global_y_position - y_amount;
    bounds = move_constant_leftwards(position, 0, bounds); // check bounds 
    return bounds; 
}

Bounds_Error_Check move_constant(Global_Position position, const Position vector) {
    Bounds_Error_Check bounds = {.x_bounds=IN_BOUNDS,.y_bounds=IN_BOUNDS,.z_bounds=IN_BOUNDS};
    // Make sure that the positions are above 0 (global position is uint32_t)
    if (position.global_x_position < vector.x_position) {
      position.global_x_position = vector.x_position; // set so it becomes 0 
      bounds.x_bounds = OUT_OF_BOUNDS_NEGATIVE;
    }
    if (position.global_y_position < vector.y_position) {
      position.global_y_position = vector.y_position; // set so it becomes 0 
      bounds.y_bounds = OUT_OF_BOUNDS_POSITIVE;
    }
    if (position.global_z_position < vector.z_position) {
      position.global_z_position = vector.z_position; // set so it becomes 0 
      bounds.z_bounds = OUT_OF_BOUNDS_NEGATIVE;
    }
    // Check max bounds
    if ((MAX_X_BOUND - vector.x_position) < position.global_x_position) {
      position.global_x_position = MAX_X_BOUND - vector.x_position; // set so it becomes max 
      bounds.z_bounds = OUT_OF_BOUNDS_POSITIVE;
    }
    if ((MAX_Y_BOUND - vector.y_position) < position.global_y_position) {
      position.global_y_position = MAX_Y_BOUND - vector.y_position; // set so it becomes max 
      bounds.z_bounds = OUT_OF_BOUNDS_NEGATIVE;
    }
    if ((MAX_Z_BOUND - vector.z_position) < position.global_z_position) {
      position.global_z_position = MAX_Z_BOUND - vector.z_position; // set so it becomes max 
      bounds.z_bounds = OUT_OF_BOUNDS_POSITIVE;
    }
    position.global_x_position = position.global_x_position + vector.x_position;
    position.global_y_position = position.global_y_position + vector.y_position;
    position.global_z_position = position.global_z_position + vector.z_position;

    return bounds; 
}

Bounds_Error_Check set_global_position(Global_Position position, const Global_Position new_position) {
  Bounds_Error_Check check;
  if (position.global_y_position > MAX_Y_BOUND) { 
    check.y_bounds = OUT_OF_BOUNDS_POSITIVE;
  } else if (position.global_y_position < MIN_Y_BOUND) {
    check.y_bounds = OUT_OF_BOUNDS_NEGATIVE;
  }
  if (position.global_z_position > MAX_Z_BOUND) {
    check.z_bounds = OUT_OF_BOUNDS_NEGATIVE;
  } else if (position.global_z_position < MIN_Z_BOUND) {
    check.z_bounds = OUT_OF_BOUNDS_POSITIVE;
  }
  if (position.global_x_position > MAX_X_BOUND) {
    check.x_bounds = OUT_OF_BOUNDS_NEGATIVE;
  } else if (position.global_x_position < MIN_X_BOUND) {
    check.x_bounds = OUT_OF_BOUNDS_POSITIVE;
  }
  return check;  
}
```

## src/terminal.h
```c
#include <zephyr/kernel.h>
#include <zephyr/shell/shell.h>
#include <zephyr/logging/log.h>

#include <stdlib.h>

#include "console_properties.h"

extern uint32_t delta_time_us;

static inline void help_terminal_cmd(const struct shell* shell_cmd, size_t argc, char** argv) {
    shell_print(shell_cmd, 
            "Help List for Custom Console         \n"
            "-------------------------------------\n"
            "help           - provides a help list\n"
            "set_delta_time - sets time step in us\n"
            "get_delta_time - gets time step in us\n"
            );
    return;
}

static inline void set_delta_time_terminal_cmd(const struct shell* shell_cmd, size_t argc, char** argv) {
    shell_print(shell_cmd, "Delta time set to: %s us", argv[1]);
    delta_time_us = atoi(argv[1]);
    return;
}

static inline void get_delta_time_terminal_cmd(const struct shell* shell_cmd, size_t argc, char** argv) {
    shell_print(shell_cmd, "Delta time is: %u us", delta_time_us);
    return;
}

SHELL_STATIC_SUBCMD_SET_CREATE(
    terminal_cmds,
    SHELL_CMD_ARG(help, NULL, "provides help list", help_terminal_cmd, 1, 0), 
    SHELL_CMD_ARG(set_delta_time, NULL, "set delta time in us", set_delta_time_terminal_cmd, 2, 0), 
    SHELL_CMD_ARG(get_delta_time, NULL, "get delta time in us", get_delta_time_terminal_cmd, 1, 0), 
    SHELL_SUBCMD_SET_END);

SHELL_CMD_REGISTER(terminal, &terminal_cmds, "Terminal Commands", NULL);
```
