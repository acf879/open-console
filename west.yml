## west.yml
```yaml
# Copyright (c) 2021 Nordic Semiconductor ASA
# SPDX-License-Identifier: Apache-2.0

manifest:
  group-filter: [+optional]
  self:
    west-commands: scripts/west-commands.yml

  remotes:
    - name: zephyrproject-rtos
      url-base: https://github.com/zephyrproject-rtos

  projects:
    - name: zephyr
      remote: zephyrproject-rtos
      
      # Update to v3.7.0-rc2 on July 5 2024
      revision: 7a10c7dff10f5dd1bd247a89c24b5756731b49ae 
      import:
        name-allowlist:
          - hal_espressif 
          - mcuboot
```
